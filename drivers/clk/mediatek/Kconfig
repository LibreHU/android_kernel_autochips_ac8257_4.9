## drivers/clk/mediatek/Kconfig
```kconfig
#
# MediaTek SoC drivers
#
config COMMON_CLK_MEDIATEK
	bool
	---help---
	  Mediatek SoCs' clock support.

config COMMON_CLK_AC8257
	bool "Clock driver for Mediatek AC8257"
	depends on COMMON_CLK
	select COMMON_CLK_MEDIATEK
	default y if MACH_AC8257 && !MTK_CLKMGR && !FPGA_EARLY_PORTING
	---help---
	  This driver supports Mediatek AC8257 clocks.
	  Use the config to support CCF on AC8257,
	  instead of old clkmgr architecture.
	  AC8257 default will use CCF.
```

## drivers/misc/autochips/Kconfig
```kconfig
comment "ATC Misc config for 3.18 kernel"


menu "ATC Misc config"

menuconfig ATC_SOLUTION
	bool "Autochips Properitary Configuration"
        default y
	help
	  Check this to enable Autochips properity configuration.

config ATC_LIB_OSAL
	tristate "ATC OS interface Driver"
	default y
	help
	  This is basic driver. If unsure say Y.

config ATC_BACKCAR
	bool "Enable Autochips Backcar feature"
	depends on ATC_AVIN
	default y
	help
	   Check this to enable autochips drivers configuration which is related to backcar.

config ATC_WCH
	tristate "ATC write channel driver"
	depends on ATC_AVIN
	default y
	help
	  ATC write channel driver.

config ATC_NR
	tristate "ATC noise reduction Driver"
	depends on ATC_AVIN
	default y
	help
	  This is noise reduction driver. If unsure say Y.

config ATC_DI
	tristate "ATC De-Interlance Driver"
	depends on ATC_AVIN
	default y
	help
	  ATC De-Interlance Driver.

config ATC_AVIN
	bool "ATC v4l2 virtual driver"
	depends on VIDEO_V4L2 && VIDEOBUF2_CORE
	default y
	help
	   Used for control tvd/wch/di/nr module

config ATC_TVD
	bool "ATC support tvd hardware which decode analog signal"
	depends on ATC_AVIN
	default y
	help
	   Used for decode analog signal in order to achieve backcar function

config ATC_BOOT_STATE
	bool "Enable ATC BOOT STATE Driver"
	default y
	help
	  Show Boot state.

config ATC_METAZONE
	tristate "Autochips Metazone Driver"
	default y
	help
	  Say Y here for supporting metazone driver.

config ATC_ARM2_LOG_BUFFER
	bool "Autochips Arm2 Log buffer manage driver."
	default y
	help
	  Say Y for supporting arm2 log buffer
endmenu
```

## drivers/misc/librehu/Kconfig
```kconfig
#
# LibreHU additions for the UJC201 (from the reverse-engineering branch of this repository).
#
menu "LibreHU (UJC201) additions"
	depends on MACH_AC8257

config AC8257_RECOVERY_MEM
	bool "Keep the SPM and SCP memory out of Linux in a recovery-partition boot"
	default y
	help
	  In a normal boot the LK reserves the SPM (0x77ff0000) and SCP (0x9f900000) memory; in a
	  recovery-partition boot it does not, and Linux would use it. Removed from memblock when
	  "recovery" is on the command line (test method from the recovery partition).

config AC8257_EARLY_PSTORE_CONSOLE
	bool "Early kernel log in the pstore console zone (bring-up)"
	depends on PSTORE_RAM && PSTORE_CONSOLE && ARM64
	help
	  Copies the kernel log into the pstore console zone from setup_arch() on, so that a kernel
	  that dies before ramoops registers still leaves its log, readable from the next boot in
	  /sys/fs/pstore/console-ramoops or /proc/last_kmsg. Only for bringing up a new kernel: once
	  it boots, say N.

config AC8257_BRINGUP_PANIC
	bool "Timed panic after boot (bring-up)"
	help
	  Panics a fixed time after boot, so that a test kernel stuck in userspace (no display, no
	  USB) reboots through the exception path with its log, init's messages included, kept in
	  pstore, instead of hanging until the unit is reflashed. Only for bringing up a new kernel.
	  Settable at run time in /sys/module/ac8257_bringup/parameters/ and with
	  ac8257_panic_secs= on the command line.

config AC8257_BRINGUP_PANIC_SECS
	int "Seconds before the timed panic"
	depends on AC8257_BRINGUP_PANIC
	default 90

config AC8257_INPUT_BOOST
	bool "Touch input boost"
	depends on MTK_CPU_FREQ
	default y
	help
	  Raises the CPU minimum frequency for a short time on a touch, through
	  the LibreHU floor of the cpufreq driver (tunables in
	  /sys/module/ac8257_input_boost/parameters/).

endmenu
```

## drivers/pinctrl/mediatek/Kconfig
```kconfig
config PINCTRL_MTK
	bool
	depends on OF
	select PINMUX
	select GENERIC_PINCONF
	select GPIOLIB
	select OF_GPIO

config PINCTRL_AC8257
	bool "Mediatek AC8257 pin control"
	default n
	depends on (!ARCH_MEDIATEK) && MACH_AC8257
	select PINCTRL_MTK
	select PINCTRL_MTK_NO_UPSTREAM
	select MTK_EINT_MULTI_TRIGGER_DESIGN

config MTK_EINT_MULTI_TRIGGER_DESIGN
	bool "Mediatek EINT multi-trigger design"
	depends on PINCTRL_MTK
	default n
	help
	  On MTK EINT design, a GPIO pin is connected to 2 EINT pin  in order to
	  save pins for assignments. Which EINT pin is actually occupied by a GPIO
	  is described in *pins and it is decided in run time.

config PINCTRL_MTK_NO_UPSTREAM
	bool "Mediatek pin control"
	depends on OF
	select PINCTRL_MTK
	help
	  Say yes here to enable support for MediaTek pinctrl debug command.
	  It can provide gpio status debug shell command.
	  We also can use these shell command to change gpio status.
	  It is common for all ICs.
	  We can use the command to debug gpio status issues.
	  we also can use it in user space.
```

## drivers/soc/cli/Kconfig
```kconfig
config CLI_AUTOCHIPS
	tristate "Commands Line Interface Driver"
	default y
	---help---
	  A user interface for AutoChips chip validation
```
